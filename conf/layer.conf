## conf/layer.conf
```bitbake
# We have a conf and classes directory, add to BBPATH
BBPATH .= ":${LAYERDIR}"

# We have recipes-* directories, add to BBFILES
BBFILES += "${LAYERDIR}/recipes-*/*/*.bb \
	${LAYERDIR}/recipes-*/*/*.bbappend"

BBFILE_COLLECTIONS += "artik-snappy"
BBFILE_PATTERN_artik-snappy = "^${LAYERDIR}/"
BBFILE_PRIORITY_artik-snappy = "6"

LAYERDEPENDS_artik-snappy = "core"
```
